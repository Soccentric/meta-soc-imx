## conf/layer.conf
```bitbake
# Layer configuration for meta-soc-imx
# Yocto Project Layer - NXP i.MX
# Compatible with Yocto scarthgap

BBPATH .= ":${LAYERDIR}"

BBFILES += "${LAYERDIR}/recipes-*/*/*.bb \
            ${LAYERDIR}/recipes-*/*/*.bbappend"

BBFILE_COLLECTIONS += "meta-soc-imx"
BBFILE_PATTERN_meta-soc-imx = "^${LAYERDIR}/"
BBFILE_PRIORITY_meta-soc-imx = "10"

LAYERDEPENDS_meta-soc-imx = "core"
LAYERDEPENDS_meta-soc-imx += "freescale-layer"
LAYERDEPENDS_meta-soc-imx += "openembedded-layer"
LAYERDEPENDS_meta-soc-imx += "meta-python"

LAYERSERIES_COMPAT_meta-soc-imx = "scarthgap kirkstone"

# Layer version
LAYERVERSION_meta-soc-imx = "1"
```
